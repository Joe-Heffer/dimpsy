// SPDX-FileCopyrightText: 2026 Joe Heffer
//
// SPDX-License-Identifier: GPL-3.0-or-later

// Prints the candidate brightness curves over a 30-minute dawn.
//
//   curves          Markdown with Mermaid charts and a PWM table, for the
//                   CI job summary
//   curves --csv    one row per minute, for spreadsheets and plotting

#include "../brightness.h"

#include <cstdio>
#include <cstring>
#include <set>

namespace {

const uint32_t dawn_minutes = 30;
const uint32_t dawn_ms = dawn_minutes * 60u * 1000u;
// How often the firmware is assumed to update the output.
const uint32_t update_ms = 100;
const unsigned resolutions[] = {8, 12, 16};

struct NamedCurve {
    const char *name;
    dimpsy::CurveParams params;
};

const NamedCurve curves[] = {
    {"Exponential (10,000:1)", {dimpsy::Curve::Exponential, 10000.0f, 2.2f}},
    {"CIE 1931 lightness", {dimpsy::Curve::CieLightness, 10000.0f, 2.2f}},
    {"Gamma 2.2", {dimpsy::Curve::Gamma, 10000.0f, 2.2f}},
};

float level_at_minute(const dimpsy::CurveParams &params, uint32_t minute) {
    return dimpsy::level(params,
                         dimpsy::ramp_position(minute * 60000u, dawn_ms));
}

// Number of different duty values the output passes through between the
// start of the dawn and until_ms. Few values means visible steps.
size_t distinct_duties(const dimpsy::CurveParams &params, unsigned bits,
                       uint32_t until_ms) {
    std::set<uint32_t> seen;
    for (uint32_t t = 0; t <= until_ms; t += update_ms) {
        seen.insert(dimpsy::duty(
            dimpsy::level(params, dimpsy::ramp_position(t, dawn_ms)), bits));
    }
    return seen.size();
}

void print_csv() {
    std::printf("minute");
    for (const auto &curve : curves) {
        std::printf(",%s", curve.name);
    }
    std::printf("\n");
    for (uint32_t minute = 0; minute <= dawn_minutes; ++minute) {
        std::printf("%u", static_cast<unsigned>(minute));
        for (const auto &curve : curves) {
            std::printf(",%.6f", level_at_minute(curve.params, minute));
        }
        std::printf("\n");
    }
}

void print_markdown() {
    std::printf("## Candidate dawn curves\n\n");
    std::printf("Relative light output over a %u-minute dawn for each "
                "candidate curve in issue #16. "
                "Generated by `firmware/core/tools/curves.cpp`.\n\n",
                static_cast<unsigned>(dawn_minutes));

    for (const auto &curve : curves) {
        std::printf("### %s\n\n", curve.name);
        std::printf("```mermaid\nxychart-beta\n");
        std::printf("  x-axis \"Minute\" [");
        for (uint32_t minute = 0; minute <= dawn_minutes; ++minute) {
            std::printf("%s%u", minute == 0 ? "" : ", ",
                        static_cast<unsigned>(minute));
        }
        std::printf("]\n  y-axis \"Output (%%)\" 0 --> 100\n  line [");
        for (uint32_t minute = 0; minute <= dawn_minutes; ++minute) {
            std::printf("%s%.2f", minute == 0 ? "" : ", ",
                        100.0f * level_at_minute(curve.params, minute));
        }
        std::printf("]\n```\n\n");
    }

    std::printf("### PWM steps at the start of the dawn\n\n");
    std::printf("Distinct duty values in the first minute and the first "
                "three minutes, updating every %u ms. "
                "More values means smoother low levels (see #8).\n\n",
                static_cast<unsigned>(update_ms));
    std::printf("| Curve | Output at 1 min |");
    for (unsigned bits : resolutions) {
        std::printf(" %u-bit, 1 min | %u-bit, 3 min |", bits, bits);
    }
    std::printf("\n| --- | --- |");
    for (unsigned bits : resolutions) {
        (void)bits;
        std::printf(" --- | --- |");
    }
    std::printf("\n");
    for (const auto &curve : curves) {
        std::printf("| %s | %.4f %% |", curve.name,
                    100.0f * level_at_minute(curve.params, 1));
        for (unsigned bits : resolutions) {
            std::printf(" %zu | %zu |",
                        distinct_duties(curve.params, bits, 60000u),
                        distinct_duties(curve.params, bits, 180000u));
        }
        std::printf("\n");
    }
}

}  // namespace

int main(int argc, char **argv) {
    if (argc > 1 && std::strcmp(argv[1], "--csv") == 0) {
        print_csv();
    } else {
        print_markdown();
    }
    return 0;
}
